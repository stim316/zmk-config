## config/boards/shields/gbpse/Kconfig.defconfig
```kconfig
if SHIELD_GBPSE_LEFT

config ZMK_KEYBOARD_NAME
    default "GBPSE"

config ZMK_SPLIT_ROLE_CENTRAL
    default y

endif

if SHIELD_GBPSE_LEFT || SHIELD_GBPSE_RIGHT

config ZMK_SPLIT
    default y

endif
```

## config/boards/shields/gbpse/Kconfig.shield
```kconfig
# Copyright (c) 2020 Pete Johanson
# SPDX-License-Identifier: MIT

config SHIELD_GBPSE_LEFT
	def_bool $(shields_list_contains,gbpse_left)

config SHIELD_GBPSE_RIGHT
	def_bool $(shields_list_contains,gbpse_right)
```
